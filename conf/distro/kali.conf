## conf/distro/kali.conf
```bitbake
DISTRO = "Kali"
DISTRO_NAME = "Kali Yocto"
DISTRO_VERSION = "0.2"
DISTRO_CODENAME = "kali"

TARGET_VENDOR = "-kali"

LOCALCONF_VERSION = "1"
LAYER_CONF_VERSION ?= "6"

SDK_NAME = "${DISTRO}-${TCLIBC}-${SDK_ARCH}-${IMAGE_BASENAME}-${TUNE_PKGARCH}"
SDKPATH = "/opt/${DISTRO}/${SDK_VERSION}"
TCLIBCAPPEND = "" 
```

## conf/layer.conf
```bitbake
# We have a conf and classes directory, add to BBPATH
BBPATH .= ":${LAYERDIR}"

# We have recipes-* directories, add to BBFILES
BBFILES += "${LAYERDIR}/recipes-*/*/*.bb \
        ${LAYERDIR}/recipes-*/*/*.bbappend"

BBFILE_COLLECTIONS += "kail-layer"
BBFILE_PATTERN_kail-layer = "^${LAYERDIR}/"
BBFILE_PRIORITY_kail-layer = "5"

# This should only be incremented on significant changes that will
# cause compatibility issues with other layers
LAYERVERSION_kali-layer = "1"

LAYERDEPENDS_kali-layer = "core"
LAYERDEPENDS_kali-layer += "openembedded-layer"
LAYERDEPENDS_kali-layer += "networking-layer"
LAYERDEPENDS_kali-layer += "xfce-layer"
LAYERDEPENDS_kali-layer += "meta-gnome"
LAYERDEPENDS_kali-layer += "meta-webserver"
LAYERDEPENDS_kali-layer += "meta-python"
LAYERDEPENDS_kali-layer += "meta-perl"
LAYERDEPENDS_kali-layer += "security"

LICENSE_PATH += "${LAYERDIR}/custom-licenses"
```
